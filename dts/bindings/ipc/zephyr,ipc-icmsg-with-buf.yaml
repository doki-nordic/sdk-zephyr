## dts/bindings/ipc/zephyr,ipc-icmsg-with-buf.yaml
```yaml
#
# Copyright (c) 2022 Nordic Semiconductor ASA
#
# SPDX-License-Identifier: Apache-2.0
#

description: Multiendpoint inter-core messaging backend with independent buffers

compatible: "zephyr,ipc-icmsg-with-buf"

include: zephyr,ipc-icmsg.yaml

properties:
  tx-blocks:
    description: number of allocable TX blocks
    required: true
    type: int

  rx-blocks:
    description: number of allocable RX blocks
    required: true
    type: int
```

## subsys/ipc/ipc_service/backends/Kconfig.icmsg_with_buf
```kconfig
# Copyright (c) 2023 Nordic Semiconductor ASA
# SPDX-License-Identifier: Apache-2.0

if IPC_SERVICE_BACKEND_ICMSG_WITH_BUF

config IPC_SERVICE_BACKEND_ICMSG_WITH_BUF_NUM_EP
	int "Endpoints number"
	range 1 251
	default 4
	help
	  Number of endpoints supported by the ICmsg with buffers IPC service
	  backend. The number of endpoints are applied to all the instances,
	  so this value should have maximum number among all the instances.

config IPC_SERVICE_BACKEND_ICMSG_WITH_BUF_SHMEM_RESET
	bool "Clear shared memory before initialization"
	help
	  Clearint TX buffer before icmsg instance initialization is needed
	  if the memory was not cleared by hardware or other software modules.
	  The memory content remaining from the previous run, or garbage data
	  is going to be incorrectly interpreted by spsc and icmsg instances.
	  This option adds performance overhead in the initialization process.

endif # IPC_SERVICE_BACKEND_ICMSG_WITH_BUF
```

## tests/subsys/ipc/ipc_sessions/interoperability/Kconfig
```kconfig
#
# Copyright (c) 2024 Nordic Semiconductor ASA
#
# SPDX-License-Identifier: LicenseRef-Nordic-5-Clause
#

config IPC_SERVICE_BACKEND_ICMSG
	default n if IPC_SERVICE_BACKEND_ICMSG_V1

config IPC_SERVICE_ICMSG
	default n if IPC_SERVICE_ICMSG_V1

config IPC_SERVICE_BACKEND_ICMSG_V1
	bool "ICMSG backend with SPSC packet buffer (old implementation)"
	default y
	depends on MBOX
	depends on DT_HAS_ZEPHYR_IPC_ICMSG_NO_UNBOUND_ENABLED
	select IPC_SERVICE_ICMSG_V1
	help
	  Chosing this backend results in single endpoint implementation based
	  on circular packet buffer.

menuconfig IPC_SERVICE_ICMSG_V1
	bool "icmsg IPC library (old implementation)"
	select PBUF_V1
	help
	  Icmsg library

if IPC_SERVICE_ICMSG_V1
	rsource "Kconfig.icmsg_v1"
endif
```

## tests/subsys/ipc/ipc_sessions/testcase.yaml
```yaml
sample:
  name: IPC Service integration test
  description: IPC Service integration and efficiency test

common:
  sysbuild: true
  tags: ipc ipc_sessions
  harness: ztest

tests:
  sample.ipc.ipc_sessions.nrf5340dk:
    platform_allow:
      - nrf5340dk/nrf5340/cpuapp
    integration_platforms:
      - nrf5340dk/nrf5340/cpuapp
  sample.ipc.ipc_sessions.nrf54h20dk_cpuapp_cpuppr:
    platform_allow:
      - nrf54h20dk/nrf54h20/cpuapp
    integration_platforms:
      - nrf54h20dk/nrf54h20/cpuapp
    extra_args: >-
      FILE_SUFFIX=cpuppr
      ipc_sessions_SNIPPET=nordic-ppr
  sample.ipc.ipc_sessions.nrf54h20dk_cpuapp_no_unbound_cpuppr:
    platform_allow:
      - nrf54h20dk/nrf54h20/cpuapp
    integration_platforms:
      - nrf54h20dk/nrf54h20/cpuapp
    extra_args: >-
      FILE_SUFFIX=cpuppr
      ipc_sessions_SNIPPET=nordic-ppr
    extra_configs:
      - CONFIG_IPC_SERVICE_BACKEND_ICMSG_V1=y
```
